## configs/chiplabsoc_defconfig
```kconfig
CONFIG_LA32R=y
CONFIG_SYS_MALLOC_F_LEN=0x600
CONFIG_DM_GPIO=y
CONFIG_DEFAULT_DEVICE_TREE="chiplab_demo"
CONFIG_DEBUG_UART_BASE=0x9fe001e0
CONFIG_DEBUG_UART_CLOCK=100000000
CONFIG_TARGET_CHIPLABSOC_DEMO=y
CONFIG_DEBUG_UART=y
CONFIG_SYS_LOAD_ADDR=0xA0000000
CONFIG_BOOTDELAY=1
CONFIG_USE_BOOTCOMMAND=y
CONFIG_BOOTCOMMAND="fatload mmc 0 0xa2000000 vmlinux;bootelf 0xa2000000 g console=ttyS0,230400 root=/dev/mmcblk0p2 rootfstype=ext4 rw rootwait loglevel=9"
# CONFIG_BOOTCOMMAND="bootelf 0xa2000000 g console=ttyS0,230400 root=/dev/mmcblk0p2 rootfstype=ext4 rw rootwait loglevel=9"
# CONFIG_BOOTCOMMAND="playmedia 0xa0200000 24"
CONFIG_DISPLAY_CPUINFO=y
CONFIG_DISPLAY_BOARDINFO_LATE=y
CONFIG_HUSH_PARSER=y
CONFIG_SYS_PROMPT="u-boot@LainSoC>> "
# CONFIG_CMD_BDI is not set
# CONFIG_CMD_CONSOLE is not set
CONFIG_CMD_BOOTZ=y
CONFIG_CMD_BOOTMENU=y
# CONFIG_CMD_EXPORTENV is not set
# CONFIG_CMD_IMPORTENV is not set
CONFIG_CMD_MEMTEST=y
CONFIG_CMD_DM=y
CONFIG_CMD_MMC=y
CONFIG_CMD_MMC_SWRITE=y
CONFIG_CMD_SPI=y
CONFIG_CMD_DHCP=y
CONFIG_CMD_TFTPSRV=y
# CONFIG_CMD_NFS is not set
CONFIG_CMD_PING=y
CONFIG_CMD_GETTIME=y
CONFIG_CMD_PLAYMEDIA=y
CONFIG_CMD_PLAYSLIDE=y
CONFIG_CMD_EXT4=y
CONFIG_CMD_EXT4_WRITE=y
CONFIG_CMD_FAT=y
CONFIG_CMD_FS_GENERIC=y
CONFIG_OF_CONTROL=y
CONFIG_OF_EMBED=y
CONFIG_NET_RANDOM_ETHADDR=y
CONFIG_NETCONSOLE=y
CONFIG_DM=y
CONFIG_CLK=y
CONFIG_MMC=y
CONFIG_MMC_OCSDC_AXI=y
# CONFIG_MMC_HW_PARTITIONING is not set
CONFIG_DM_ETH=y
CONFIG_ETHOC=y
CONFIG_XILINX_EMACLITE=y
CONFIG_BAUDRATE=230400
CONFIG_DM_SERIAL=y
CONFIG_DEBUG_UART_ANNOUNCE=y
CONFIG_SYS_NS16550=y
CONFIG_SPI=y
CONFIG_DM_SPI=y
CONFIG_SPI_MEM=y
CONFIG_LOONGSON_SPI=y
CONFIG_USB=y
CONFIG_USB_DWC2=y
CONFIG_USB_DWC2_BUFFER_SIZE=8
CONFIG_CMD_DHRYSTONE=y
```
